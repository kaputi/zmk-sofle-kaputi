## config/west.yml
```yaml
manifest:
  remotes:
    - name: zmkfirmware
      url-base: https://github.com/zmkfirmware
  projects:
    - name: zmk
      remote: zmkfirmware
      revision: v2.4  # Stable!
      import: app/west.yml
    - name: zmk-config
      path: config
      revision: main
  self:
    path: config
```
