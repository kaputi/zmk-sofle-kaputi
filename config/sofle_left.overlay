#include <dt-bindings/zmk/matrix_transform.h>

&pro_micro_i2c {
    status = "okay";
    clock-frequency = <100000>;

    oled: ssd1306@3d {
        compatible = "solomon,ssd1306fb";
        reg = <0x3d>;
        width = <128>;
        height = <64>;
        segment-offset = <0>;
        page-offset = <0>;
        display-offset = <0>;
        multiplex-ratio = <63>;
        segment-remap;
        com-invdir;
        com-sequential;
        inversion-on;
        prechargep = <0x22>;
    };
};
